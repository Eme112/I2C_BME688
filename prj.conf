## CMakeLists.txt
```
# SPDX-License-Identifier: Apache-2.0

cmake_minimum_required(VERSION 3.20.0)
find_package(Zephyr REQUIRED HINTS $ENV{ZEPHYR_BASE})
project(i2cCommBME688)

# Add the BME68x driver library
# Add the BME68x driver library directory to the include path
zephyr_include_directories(drivers/bme688/BME68x-Sensor-API)
# Add the BME68x driver source file
zephyr_library_sources(drivers/bme688/BME68x-Sensor-API/bme68x.c)
# Add the BME688 driver library directory to the include path
zephyr_include_directories(drivers/bme688/)
# Add the BME688 driver source file
zephyr_library_sources(drivers/bme688/bme688.c)

# Set target sources
# FILE(GLOB app_sources src/*.c src/*.cpp)
# target_sources(app PRIVATE ${app_sources})
target_sources(app PRIVATE src/main.c src/bme688Facade.c)
```

## Kconfig
```
#
# Copyright (c) 2020 Nordic Semiconductor ASA
#
# SPDX-License-Identifier: LicenseRef-Nordic-5-Clause
#

menu "Zephyr Kernel"
source "Kconfig.zephyr"
endmenu

module = SENSORS_SERVER
module-str = sensor_server
source "${ZEPHYR_BASE}/subsys/logging/Kconfig.template.log_config"

config SONSORS_SERVER_LOW_POWER
	bool "Enable low power mode for the CLI sample"
```

## prj.conf
```kconfig
#
# Copyright (c) 2020 Nordic Semiconductor
#
# SPDX-License-Identifier: LicenseRef-Nordic-5-Clause
#

#App dependencies
CONFIG_PWM=y
CONFIG_GPIO=y
CONFIG_ADC=y

# Logging
CONFIG_LOG=y
# CONFIG_LOG_DEFAULT_LEVEL=4  # Set the default log level (0=none, 1=err, 2=wrn, 3=inf, 4=dbg)
CONFIG_LOG_MODE_IMMEDIATE=y  # Optional: Immediate logging mode
CONFIG_SENSORS_SERVER_LOG_LEVEL_INF=y

#Light Sensor
CONFIG_I2C=y
CONFIG_SENSOR=y
CONFIG_BME680=y

# --------- OpenThread Device ------------
CONFIG_OPENTHREAD_NORDIC_LIBRARY_FTD=y
CONFIG_OPENTHREAD_FTD=y
CONFIG_OPENTHREAD_MTD=n
CONFIG_OPENTHREAD_MANUAL_START=n
CONFIG_OPENTHREAD_DEFAULT_TX_POWER=8

# --------- OpenThread Joiner ------------
CONFIG_OPENTHREAD_JOINER=y
CONFIG_OPENTHREAD_JOINER_AUTOSTART=y
CONFIG_OPENTHREAD_JOINER_PSKD="ABCDE2"
CONFIG_OPENTHREAD_SLAAC=y
# --------- ------------ ------------

#C++
CONFIG_CPLUSPLUS=y
CONFIG_LIB_CPLUSPLUS=y

CONFIG_EXCEPTIONS=y
CONFIG_NEWLIB_LIBC=y
CONFIG_NEWLIB_LIBC_NANO=n

CONFIG_STD_CPP11=n
CONFIG_STD_CPP17=y

#Stack
CONFIG_MAIN_STACK_SIZE=8192

#safe silence of ABI change warning as using gcc > 7 https://github.com/nlohmann/json/issues/1861
CONFIG_COMPILER_OPT="-Wno-psabi"

#print float
CONFIG_NEWLIB_LIBC=y
CONFIG_NEWLIB_LIBC_FLOAT_PRINTF=y
```

## src/main.c
```c
/*
 * Copyright (c) 2016 Intel Corporation
 *
 * SPDX-License-Identifier: Apache-2.0
 */

#include <stdio.h>
#include <zephyr/kernel.h>
#include <zephyr/logging/log.h>

#include "bme688Facade.h"

int main(void)
{	
	start_bme688();

	for (;;) {
		bme688_get_data();
		k_sleep(K_SECONDS(5));
	}
}
```

## src/bme688Facade.c
```c
#include "bme688Facade.h"

// Logging module for the sensor server
LOG_MODULE_REGISTER(sensor_server_logger, LOG_LEVEL_DBG);

// Struct to initialize bme68x sensor
const struct device *const dev = DEVICE_DT_GET_ONE(bosch_bme688);

// Pointer to the BME688 sensor
const struct device *sensor_dev_bme688;

// Initialize bme68x sensor
void start_bme688() {
	LOG_INF("Starting BME688 sensor");

	if (!device_is_ready(dev)) {
		LOG_ERR("Device %s is not ready", dev->name);
		return;
	}

	LOG_INF("Device %s is ready", dev->name);

	if (bme688_init(dev) != 0) {
		LOG_ERR("Failed to initialize BME688 sensor");
		return;
	}

	bme688_mode_t mode = bme688_mode_forced; // BME688_MODE_FORCED, BME688_MODE_PARALLEL, BME688_MODE_SEQUENTIAL
	bme688_set_mode_default_conf(mode);
	LOG_INF("BME688 sensor started, MODE: %s", mode == bme688_mode_forced ? "FORCED" : mode == bme688_mode_parallel ? "PARALLEL" : mode == bme688_mode_sequencial ? "SEQUENTIAL" : "SLEEP");
}

// Obtain data from sensor
void bme688_get_data() {
	uint8_t last_index = 1;
	int measure_count = 0;
	struct bme68x_data data[3];
	
	bme688_sample_fetch(dev,SENSOR_CHAN_ALL);
	uint8_t n_fields = bme688_data_get(dev, data);

	if (n_fields != 0) {
		for (uint8_t i = 0; i < n_fields; i++) {
			if (data[i].gas_index < last_index) {
				LOG_DBG("---");
				measure_count++;
			}
			last_index = data[i].gas_index;
			if ((data[i].status & BME68X_NEW_DATA_MSK) &&
				(data[i].status & BME68X_GASM_VALID_MSK)
				) {

					LOG_DBG("sample:%d (%u/%d) : %.2f° , %.2f Pa , %.2f %% , %s %.2f ohm",
						measure_count,
						data[i].meas_index,
						data[i].gas_index,
						data[i].temperature,
						data[i].pressure,
						data[i].humidity,
						(data[i].status & BME68X_HEAT_STAB_MSK)?"":"(nhs)",
						data[i].gas_resistance);
			}
		}
	} else {
		LOG_INF("n_fields=%d;",n_fields);
	}
}
```

## src/bme688Facade.h
```c
#include <zephyr/kernel.h>
#include <zephyr/logging/log.h>
#include <zephyr/drivers/sensor.h>

#include "bme68x.h"
#include "bme688.h"
#include "bme68x_defs.h"

// Initialize bme68x sensor
void start_bme688();

// Obtain data from sensor
void bme688_get_data();
```
